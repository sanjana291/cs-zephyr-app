## Kconfig
```kconfig
rsource "modules/iol-master/Kconfig"

# Future drivers — uncomment
# rsource "modules/calixto-ethernet/Kconfig"
# rsource "modules/calixto-eeprom/Kconfig"
# rsource "modules/calixto-wifi/Kconfig"
```

## modules/iol-master/Kconfig
```kconfig
config IOL_MASTER
    bool "IO-Link Master stack support"
    depends on SPI && GPIO
    help
      Enables the IO-Link Master middleware
      with CCE4511 PHY driver ported to Zephyr.

if IOL_MASTER

config IOL_MASTER_NUM_CHANNELS
    int "Number of IO-Link channels"
    default 4
    range 1 4

config IOL_MASTER_STACK_SIZE
    int "IO-Link task stack size (bytes)"
    default 4096

config IOL_MASTER_TASK_PRIORITY
    int "IO-Link Master thread task priority"
    default 4
    help
      Must be lower than the IO-Link Driver Layer task priority

config IOL_DL_STACK_SIZE
    int "IO-Link Driver Layer task stack size (bytes)"
    default 2048

config IOL_DL_TASK_PRIORITY
    int "IO-Link DL thread task priority"
    default 5
    help
      Must be higher than the IO-Link Master task priority

module = IOL_MASTER
module-str = IO-Link Master
source "subsys/logging/Kconfig.template.log_config"

endif
```

## west.yml
```yaml
manifest:
  self:
    path: cs-zephyr-app

  remotes:
    - name: zephyrproject-rtos
      url-base: https://github.com/zephyrproject-rtos/zephyr

  projects:
    - name: zephyr
      remote: zephyrproject-rtos
      revision: v3.7.2
      import:
        name-allowlist:
          - cmsis
          - cmsis_6
          - hal_nxp
          - hal_stm32
          - hal_nordic
          - hal_espressif
          - mcuboot
          - tinycrypt
          - mbedtls
          - zcbor
          - littlefs
```
